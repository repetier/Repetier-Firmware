#include "../Repetier.h"
#include "mcu.h"

static uint8_t crc_j1850_hashes[] = {
    0x90, 0x1D, 0x3A, 0x27, 0x74, 0x69, 0x4E, 0x53,
    0xE8, 0xF5, 0xD2, 0xCF, 0x9C, 0x81, 0xA6, 0xBB,
    0xCD, 0xD0, 0xF7, 0xEA, 0xB9, 0xA4, 0x83, 0x9E,
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    0x97, 0x8A, 0xAD, 0xB0, 0xE3, 0xFE, 0xD9, 0xC4
};

CRC8_J1850::CRC8_J1850()
    : crc(0xFF) { }

void CRC8_J1850::init() {
    crc = 0xff;
}

void CRC8_J1850::add(uint8_t val) {
    crc = crc_j1850_hashes[crc ^ val];
}

void CRC8_J1850::addArray(uint8_t* data, int length) {
    while (length--) {
        crc = crc_j1850_hashes[crc ^ *data++];
    }
}

uint8_t CRC8_J1850::finish() {
    crc = ~crc;
    return crc;
}

void MCUData::prepareSending(uint8_t mcuId, uint16_t functionId) {
    crc.init();
    pos = 0;
    header.mcuId = mcuId;
    header.command = functionId;
}

void MCUData::dataComplete() {
    header.crc = crc.finish();
    header.length = pos;
}

void MCUData::appendBytes(void* ptr, int length) {
    uint8_t* p = static_cast<uint8_t*>(ptr);
    while (length--) {
        data[pos++] = *p;
        crc.add(*p++);
    }
}

void MCUData::appendI8(int8_t x) {
    appendBytes(&x, 1);
}
void MCUData::appendU8(uint8_t x) {
    appendBytes(&x, 1);
}
void MCUData::appendI16(int16_t x) {
    appendBytes(&x, 2);
}
void MCUData::appendU16(uint16_t x) {
    appendBytes(&x, 2);
}
void MCUData::appendI32(int32_t x) {
    appendBytes(&x, 4);
}
void MCUData::appendU32(uint32_t x) {
    appendBytes(&x, 4);
}
void MCUData::appendF(float x) {
    appendBytes(&x, 4);
}
void MCUData::appendS(char* s) {
    uint8_t* p = reinterpret_cast<uint8_t*>(s);
    while (true) {
        data[pos++] = *p;
        crc.add(*p);
        if (p == 0) {
            break;
        }
        p++;
    }
}

bool MCUData::prepareRead() {
    crc.init();
    crc.addArray(data, header.length);
    pos = 0;
    return header.crc == crc.finish();
}

void MCUData::readBytes(void* ptr, int length) {
    uint8_t* p = static_cast<uint8_t*>(ptr);
    while (length--) {
        *p++ = data[pos++];
    }
}
int8_t MCUData::readI8() {
    int8_t x;
    readBytes(&x, 1);
    return x;
}
uint8_t MCUData::readU8() {
    uint8_t x;
    readBytes(&x, 1);
    return x;
}
int16_t MCUData::readI16() {
    int16_t x;
    readBytes(&x, 2);
    return x;
}
uint16_t MCUData::readU16() {
    uint16_t x;
    readBytes(&x, 2);
    return x;
}
int32_t MCUData::readI32() {
    int32_t x;
    readBytes(&x, 4);
    return x;
}
uint32_t MCUData::readU32() {
    uint32_t x;
    readBytes(&x, 4);
    return x;
}
float MCUData::readFloat() {
    float x;
    readBytes(&x, 4);
    return x;
}
char* MCUData::readS() {
    char* s = reinterpret_cast<char*>(&data[pos]);
    while (data[pos++]) { }
    pos++; // skip ending zero as well
    return s;
}
